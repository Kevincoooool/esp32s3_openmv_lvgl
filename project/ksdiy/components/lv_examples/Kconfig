## project/ksdiy/components/lv_examples/Kconfig
```kconfig
# Kconfig for lv_examples v7.4.0

menu "lv_examples configuration"

    config LV_EX_PRINTF
        bool "Enable printf-ing data in demos and examples."
    
    choice LV_EX_CHOICE
        prompt "Select the demo you want to run."
        default LV_USE_DEMO_WIDGETS

        config LV_USE_DEMO_WIDGETS
            bool "Show demo widgets."

        config LV_DEMO_WIDGETS_SLIDESHOW
            bool "Slide demo widgets automatically."
            depends on LV_USE_DEMO_WIDGETS
            default y

        config LV_USE_DEMO_KEYPAD_AND_ENCODER
            bool "Demonstrate the usage of encoder and keyboard."

        config LV_USE_DEMO_BENCHMARK
            bool "Benchmark your system."

        config LV_USE_DEMO_STRESS
            bool "Stress test for LVGL."

        config LV_USE_DEMO_MUSIC 
            bool "music test for LVGL."

        config LV_DEMO_MUSIC_LANDSCAPE
            bool "support landscape support."
            depends on LV_USE_DEMO_MUSIC
            default y

        config LV_DEMO_MUSIC_LARGE
            bool "support large font."
            depends on LV_USE_DEMO_MUSIC
            default n

        config LV_DEMO_MUSIC_AUTO_PLAY
            bool "a ~60 sec demo will be played.."
            depends on LV_USE_DEMO_MUSIC
            default y
    endchoice
endmenu
```
